## conf/layer.conf
```bitbake
# We have a conf and classes directory, add to BBPATH
BBPATH .= ":${LAYERDIR}"

# We have recipes-* directories, add to BBFILES
BBFILES += "${LAYERDIR}/recipes-*/*/*.bb \
            ${LAYERDIR}/recipes-*/*/*.bbappend"

BBFILE_COLLECTIONS += "meta-pco-ml"
BBFILE_PATTERN_meta-pco-ml = "^${LAYERDIR}/"
BBFILE_PRIORITY_meta-pco-ml = "6"

LAYERDEPENDS_meta-pco-ml = "core"
LAYERSERIES_COMPAT_meta-pco-ml = "kirkstone"
```
